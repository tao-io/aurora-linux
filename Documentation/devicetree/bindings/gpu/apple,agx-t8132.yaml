## Documentation/devicetree/bindings/gpu/apple,agx-t8132.yaml
```yaml
# SPDX-License-Identifier: (GPL-2.0-only OR BSD-2-Clause)
%YAML 1.2
---
$id: http://devicetree.org/schemas/gpu/apple,agx-t8132.yaml#
$schema: http://devicetree.org/meta-schemas/core.yaml#

title: Apple T8132 G16G GPU inherited firmware resources

maintainers:
  - Sasha Finkelstein <k@chaosmail.tech>

description: |
  J713 single-GFX resource handoff. Firmware is already loaded by the boot
  chain. The bootloader publishes its actual reserved physical ranges and
  corresponding firmware virtual addresses in standard FDT byte order.
  These properties describe resources, not firmware authentication, an ABI
  version, or a grant of UAT ownership. Runtime startup must establish those
  separately. Disabled source-tree nodes have unpopulated reserved regions;
  apple,g16-handoff-version is written only after all regions are published.

properties:
  compatible:
    const: apple,agx-t8132

  reg:
    items:
      - description: GFX ASC CPU control aperture
      - description: SGX register aperture

  reg-names:
    items:
      - const: asc
      - const: sgx

  mboxes:
    maxItems: 1

  power-domains:
    maxItems: 1

  memory-region:
    items:
      - description: UAT TTBAT
      - description: Inherited shared page tables
      - description: Firmware and host UAT handoff
      - description: Inherited shared L2 page table
      - description: Loaded GFX firmware __TEXT
      - description: Loaded GFX firmware __DATA

  memory-region-names:
    items:
      - const: ttbs
      - const: pagetables
      - const: handoff
      - const: shared-l2
      - const: fw-text
      - const: fw-data

  apple,g16-handoff-version:
    $ref: /schemas/types.yaml#/definitions/uint32
    const: 1
    description: |
      Version of this resource publication contract. Present only after the
      bootloader populated all six nonoverlapping no-map reserved regions.

  apple,firmware-segment-vas:
    $ref: /schemas/types.yaml#/definitions/uint64-array
    minItems: 2
    maxItems: 2
    description: Firmware virtual addresses for fw-text and fw-data, in that order.

  apple,firmware-segment-flags:
    $ref: /schemas/types.yaml#/definitions/uint32-array
    items:
      - const: 1
      - const: 0
    description: Inherited ADT segment flags for fw-text and fw-data.

required:
  - compatible
  - reg
  - reg-names
  - mboxes
  - power-domains
  - memory-region
  - memory-region-names

dependencies:
  apple,g16-handoff-version:
    - apple,firmware-segment-vas
    - apple,firmware-segment-flags

additionalProperties: false
```

## drivers/gpu/drm/apple/Kconfig
```kconfig
# SPDX-License-Identifier: GPL-2.0-only OR MIT
config DRM_APPLE_M4_DCPEXT
	bool "Apple M4 J713 external DisplayPort"
	depends on DRM=y && ARM64 && ARCH_APPLE && OF && ARM64_16K_PAGES
	depends on TYPEC_SN201202X=y
	select MFD_SYSCON
	select DRM_KMS_HELPER
	select DRM_GEM_DMA_HELPER
	help
	  Build the J713 external display runtime into the kernel. Requires the
	  reserved firmware and DART handoff from the M4 bootloader. The driver
	  waits for a supported USB-C display connection without blocking boot,
	  then publishes a DRM connector with monitor identity and modes.
	  Shutdown is handled by the kernel; no explicit module load is needed.
	  Sleep, firmware restart and broader display features remain unsupported.

config DRM_APPLE_M4_DCPEXT_AUDIO
	tristate "Apple M4 J713 external display audio"
	depends on DRM_APPLE_M4_DCPEXT && SND && APPLE_SIO
	select SND_DMAENGINE_PCM
	help
	  PCM playback through the M4 DCP audio service and SIO DMA.
	  Initial qualification supports stereo 48 kHz S16_LE on DCPEXT0.
	  Does not enable the laptop's internal speakers or headphone codec.

config DRM_APPLE
	tristate "DRM Support for Apple display controllers"
	depends on DRM && OF && ARM64
	depends on ARCH_APPLE || COMPILE_TEST
	depends on APPLE_RTKIT
	depends on OF_ADDRESS
	select APPLE_PMP_REPORT
	select DRM_CLIENT_SELECTION
	select DRM_KMS_HELPER
	select DRM_KMS_DMA_HELPER
	select DRM_GEM_DMA_HELPER
	select VIDEOMODE_HELPERS
	depends on BACKLIGHT_CLASS_DEVICE
	select MULTIPLEXER
	help
	  Say Y if you have an Apple Silicon chipset.

config DRM_APPLE_AUDIO
	bool "DisplayPort/HDMI Audio support"
	default y
	depends on DRM_APPLE
	depends on SND
	select SND_PCM
	select SND_DMAENGINE_PCM

config DRM_APPLE_DEBUG
	bool "Enable additional driver debugging"
	depends on DRM_APPLE
	depends on EXPERT # only for developers

config DRM_APPLE_KUNIT_TEST
	tristate "KUnit tests for the Apple display driver" if !KUNIT_ALL_TESTS
	depends on DRM_APPLE && KUNIT
	default KUNIT_ALL_TESTS
	help
	  Build focused unit tests for Apple display lifecycle helpers and DCPLink
	  message encoders. The tests do not access display hardware. If in doubt,
	  say "N".
```
